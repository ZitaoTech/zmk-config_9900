## config/boards/bb9900/Kconfig.board
```kconfig
# Copyright (c) 2023 ZitaoTech
# SPDX-License-Identifier: MIT

config BOARD_BB9900
    bool "bb9900"
    depends on SOC_NRF52840_QIAA
```

## config/boards/bb9900/Kconfig.defconfig
```kconfig
# Copyright (c) 2023 ZitaoTech
# SPDX-License-Identifier: MIT

if BOARD_BB9900

config ZMK_KEYBOARD_NAME
    default "bb9900"

if USB_DEVICE_STACK

config USB_NRFX
    default y

endif # USB_DEVICE_STACK

if ZMK_BACKLIGHT

config PWM
    default y

config LED_PWM
    default y

endif # ZMK_BACKLIGHT

config BT_CTLR
    default BT

endif # BOARD_BB9900
```

## config/boards/bb9900/bb9900_defconfig
```kconfig
# Copyright (c) 2023 ZitaoTech
# SPDX-License-Identifier: MIT

CONFIG_SOC_SERIES_NRF52X=y
CONFIG_SOC_NRF52840_QIAA=y
CONFIG_BOARD_BB9900=y


# Enable MPU
CONFIG_ARM_MPU=y

CONFIG_PINCTRL=y

# enable GPIO
CONFIG_GPIO=y

# Build Configuration
CONFIG_USE_DT_CODE_PARTITION=y
CONFIG_BUILD_OUTPUT_UF2=y

# Flash configuration
CONFIG_MPU_ALLOW_FLASH_WRITE=y
CONFIG_NVS=y
CONFIG_SETTINGS_NVS=y
CONFIG_FLASH=y
CONFIG_FLASH_PAGE_LAYOUT=y
CONFIG_FLASH_MAP=y

# Enable Signal Power Plus
CONFIG_BT_CTLR_TX_PWR_PLUS_8=y

# Sleep Setting
CONFIG_ZMK_SLEEP=n
CONFIG_ZMK_EXT_POWER=y
CONFIG_ZMK_IDLE_TIMEOUT=30000


# Indicator for Cpaslock Setting
CONFIG_ZMK_INDICATOR_CAPSLOCK=y
CONFIG_ZMK_INDICATOR_CAPSLOCK_BRT=100

# Indicator for Layer Setting
CONFIG_ZMK_INDICATOR_LED=y
CONFIG_ZMK_IDICATOR_LAYER_BRT=100
CONFIG_ZMK_IDICATOR_LAYER_CYCLE_MAXBRT=100
CONFIG_ZMK_IDICATOR_LAYER_CYCLE_MINBRT=20
CONFIG_ZMK_IDICATOR_LAYER_CYCLE_INTERVAL=20
CONFIG_ZMK_IDICATOR_BRT_STEP=5

# Keyboard backlight Setting
CONFIG_ZMK_BACKLIGHT=y
CONFIG_ZMK_BACKLIGHT_BRT_START=40
CONFIG_ZMK_BACKLIGHT_BRT_STEP=10
CONFIG_ZMK_BACKLIGHT_ON_START=y
CONFIG_ZMK_BACKLIGHT_AUTO_OFF_IDLE=y

# HID indicator configuration
CONFIG_ZMK_HID_INDICATORS=y

# Enable Mouse Emulation
CONFIG_ZMK_MOUSE=y

# Debuncing Setting 
CONFIG_ZMK_KSCAN_DEBOUNCE_PRESS_MS=10
CONFIG_ZMK_KSCAN_DEBOUNCE_RELEASE_MS=10

# Enable both USB and BLE
CONFIG_ZMK_USB=y
CONFIG_ZMK_BLE=y

# Milliseconds to wait after a setting change before writing it to flash memory
CONFIG_ZMK_SETTINGS_SAVE_DEBOUNCE=10000

# Log via USB or Segger RTT
CONFIG_ZMK_USB_LOGGING=n
```

## config/west.yml
```yaml
manifest:
  remotes:
    - name: zmkfirmware
      url-base: https://github.com/zmkfirmware
    - name: ZitaoTech
      url-base: https://github.com/ZitaoTech
  projects:
    - name: zmk_zitao
      remote: ZitaoTech
      revision: bbkeyboard_tp
      import: app/west.yml
  self:
    path: config
```
